/******************************************************************************
* ASAP2 file: HANcoder_E407_DYS_MP.a2l
* Academic License - for use in teaching, academic research, and meeting
* course requirements at degree granting institutions only. Not for
* government, commercial, or other organizational use.
* Code generation for model "HANcoder_E407_DYS_MP".
* Model version : 1.136
* Simulink Coder version : 9.0 (R2018b) 24-May-2018
* C source code generated on : Tue Jun 20 01:51:50 2023
* Target selection: ert.tlc
* Embedded hardware selection: ARM Compatible->ARM Cortex
* Code generation objectives: Unspecified
* Validation result: Not run
* (add additional file header information here)
******************************************************************************/ ASAP2_VERSION 1 31
/* Version 1.31 */
/begin PROJECT ProjectName "HANcoder_E407_DYS_MP_softwareID_v1_200623_015142"
/begin HEADER "Header Comments go here" /end HEADER
/begin MODULE ModuleName "Module Comment Goes Here"
/begin MOD_PAR "MOD PAR Comment Goes Here" ADDR_EPK 0x0800c03c CPU_TYPE "STM32F407" ECU "E407" EPK "HANcoder_E407_DYS_MP_softwareID_v1_200623_015142"
 SYSTEM_CONSTANT "XcpStationID string length" "0x00000030"
 SYSTEM_CONSTANT "RAM-FlashOffset" "-402521248" /end MOD_PAR
/begin MOD_COMMON "Mod Common Comment Here" BYTE_ORDER MSB_LAST /end MOD_COMMON
/begin RECORD_LAYOUT Scalar_BOOLEAN FNC_VALUES 1 UBYTE COLUMN_DIR DIRECT /end RECORD_LAYOUT
/begin RECORD_LAYOUT Scalar_UBYTE FNC_VALUES 1 UBYTE COLUMN_DIR DIRECT /end RECORD_LAYOUT
/begin RECORD_LAYOUT Scalar_BYTE FNC_VALUES 1 SBYTE COLUMN_DIR DIRECT /end RECORD_LAYOUT
/begin RECORD_LAYOUT Scalar_UWORD FNC_VALUES 1 UWORD COLUMN_DIR DIRECT /end RECORD_LAYOUT
/begin RECORD_LAYOUT Scalar_SWORD FNC_VALUES 1 SWORD COLUMN_DIR DIRECT /end RECORD_LAYOUT
/begin RECORD_LAYOUT Scalar_ULONG FNC_VALUES 1 ULONG COLUMN_DIR DIRECT /end RECORD_LAYOUT
/begin RECORD_LAYOUT Scalar_LONG FNC_VALUES 1 SLONG COLUMN_DIR DIRECT /end RECORD_LAYOUT
/begin RECORD_LAYOUT Scalar_FLOAT32_IEEE FNC_VALUES 1 FLOAT32_IEEE COLUMN_DIR DIRECT /end RECORD_LAYOUT
/begin RECORD_LAYOUT Scalar_FLOAT64_IEEE FNC_VALUES 1 FLOAT64_IEEE COLUMN_DIR DIRECT /end RECORD_LAYOUT
/begin RECORD_LAYOUT Lookup1D_BYTE FNC_VALUES 1 SBYTE COLUMN_DIR DIRECT /end RECORD_LAYOUT
/begin RECORD_LAYOUT Lookup1D_X_BYTE AXIS_PTS_X 1 SBYTE INDEX_INCR DIRECT /end RECORD_LAYOUT
/begin RECORD_LAYOUT Lookup1D_UBYTE FNC_VALUES 1 UBYTE COLUMN_DIR DIRECT /end RECORD_LAYOUT
/begin RECORD_LAYOUT Lookup1D_X_UBYTE AXIS_PTS_X 1 UBYTE INDEX_INCR DIRECT /end RECORD_LAYOUT
/begin RECORD_LAYOUT Lookup1D_UWORD FNC_VALUES 1 UWORD COLUMN_DIR DIRECT /end RECORD_LAYOUT
/begin RECORD_LAYOUT Lookup1D_X_UWORD AXIS_PTS_X 1 UWORD INDEX_INCR DIRECT /end RECORD_LAYOUT
/begin RECORD_LAYOUT Lookup1D_WORD FNC_VALUES 1 SWORD COLUMN_DIR DIRECT /end RECORD_LAYOUT
/begin RECORD_LAYOUT Lookup1D_X_WORD AXIS_PTS_X 1 SWORD INDEX_INCR DIRECT /end RECORD_LAYOUT
/begin RECORD_LAYOUT Lookup1D_ULONG FNC_VALUES 1 ULONG COLUMN_DIR DIRECT /end RECORD_LAYOUT
/begin RECORD_LAYOUT Lookup1D_X_ULONG AXIS_PTS_X 1 ULONG INDEX_INCR DIRECT /end RECORD_LAYOUT
/begin RECORD_LAYOUT Lookup1D_SLONG FNC_VALUES 1 SLONG COLUMN_DIR DIRECT /end RECORD_LAYOUT
/begin RECORD_LAYOUT Lookup1D_X_LONG AXIS_PTS_X 1 SLONG INDEX_INCR DIRECT /end RECORD_LAYOUT
/begin RECORD_LAYOUT Lookup1D_FLOAT32_IEEE FNC_VALUES 1 FLOAT32_IEEE COLUMN_DIR DIRECT /end RECORD_LAYOUT
/begin RECORD_LAYOUT Lookup1D_X_FLOAT32_IEEE AXIS_PTS_X 1 FLOAT32_IEEE INDEX_INCR DIRECT /end RECORD_LAYOUT
/begin RECORD_LAYOUT Lookup1D_FLOAT64_IEEE FNC_VALUES 1 FLOAT64_IEEE COLUMN_DIR DIRECT /end RECORD_LAYOUT
/begin RECORD_LAYOUT Lookup1D_X_FLOAT64_IEEE AXIS_PTS_X 1 FLOAT64_IEEE INDEX_INCR DIRECT /end RECORD_LAYOUT
/begin RECORD_LAYOUT Lookup2D_UBYTE FNC_VALUES 1 UBYTE COLUMN_DIR DIRECT /end RECORD_LAYOUT
/begin RECORD_LAYOUT Lookup2D_X_UBYTE AXIS_PTS_X 1 UBYTE INDEX_INCR DIRECT /end RECORD_LAYOUT
/begin RECORD_LAYOUT Lookup2D_BYTE FNC_VALUES 1 SBYTE COLUMN_DIR DIRECT /end RECORD_LAYOUT
/begin RECORD_LAYOUT Lookup2D_X_BYTE AXIS_PTS_X 1 SBYTE INDEX_INCR DIRECT /end RECORD_LAYOUT
/begin RECORD_LAYOUT Lookup2D_UWORD FNC_VALUES 1 UWORD COLUMN_DIR DIRECT /end RECORD_LAYOUT
/begin RECORD_LAYOUT Lookup2D_X_UWORD AXIS_PTS_X 1 UWORD INDEX_INCR DIRECT /end RECORD_LAYOUT
/begin RECORD_LAYOUT Lookup2D_WORD FNC_VALUES 1 SWORD COLUMN_DIR DIRECT /end RECORD_LAYOUT
/begin RECORD_LAYOUT Lookup2D_X_WORD AXIS_PTS_X 1 SWORD INDEX_INCR DIRECT /end RECORD_LAYOUT
/begin RECORD_LAYOUT Lookup2D_ULONG FNC_VALUES 1 ULONG COLUMN_DIR DIRECT /end RECORD_LAYOUT
/begin RECORD_LAYOUT Lookup2D_X_ULONG AXIS_PTS_X 1 ULONG INDEX_INCR DIRECT /end RECORD_LAYOUT
/begin RECORD_LAYOUT Lookup2D_LONG FNC_VALUES 1 SLONG COLUMN_DIR DIRECT /end RECORD_LAYOUT
/begin RECORD_LAYOUT Lookup2D_X_LONG AXIS_PTS_X 1 SLONG INDEX_INCR DIRECT /end RECORD_LAYOUT
/begin RECORD_LAYOUT Lookup2D_FLOAT32_IEEE FNC_VALUES 1 FLOAT32_IEEE COLUMN_DIR DIRECT /end RECORD_LAYOUT
/begin RECORD_LAYOUT Lookup2D_X_FLOAT32_IEEE AXIS_PTS_X 1 FLOAT32_IEEE INDEX_INCR DIRECT /end RECORD_LAYOUT
/begin RECORD_LAYOUT Lookup2D_FLOAT64_IEEE FNC_VALUES 1 FLOAT64_IEEE COLUMN_DIR DIRECT /end RECORD_LAYOUT
/begin RECORD_LAYOUT Lookup2D_X_FLOAT64_IEEE AXIS_PTS_X 1 FLOAT64_IEEE INDEX_INCR DIRECT /end RECORD_LAYOUT
/begin CHARACTERISTIC HantuneAngleSp "" VALUE 0x20000008 Scalar_FLOAT64_IEEE 0 HANcoder_E407_DYS_MP_CM_double -1.7E+308 1.7E+308 /end CHARACTERISTIC
/begin CHARACTERISTIC positionD "" VALUE 0x20000010 Scalar_FLOAT64_IEEE 0 HANcoder_E407_DYS_MP_CM_double -1.7E+308 1.7E+308 /end CHARACTERISTIC
/begin CHARACTERISTIC positionI "" VALUE 0x20000018 Scalar_FLOAT64_IEEE 0 HANcoder_E407_DYS_MP_CM_double -1.7E+308 1.7E+308 /end CHARACTERISTIC
/begin CHARACTERISTIC positionP "" VALUE 0x20000020 Scalar_FLOAT64_IEEE 0 HANcoder_E407_DYS_MP_CM_double -1.7E+308 1.7E+308 /end CHARACTERISTIC
/begin MEASUREMENT PosRound "" FLOAT64_IEEE HANcoder_E407_DYS_MP_CM_double 0 0 -1.7E+308 1.7E+308 ECU_ADDRESS 0x20000768 /end MEASUREMENT
/begin MEASUREMENT Position "" FLOAT64_IEEE HANcoder_E407_DYS_MP_CM_double 0 0 -1.7E+308 1.7E+308 ECU_ADDRESS 0x20000770 /end MEASUREMENT
/begin MEASUREMENT ErrorPID "" FLOAT64_IEEE HANcoder_E407_DYS_MP_CM_double 0 0 -1.7E+308 1.7E+308 ECU_ADDRESS 0x200006e8 /end MEASUREMENT
/begin MEASUREMENT EncoderValueTestErrorView "" FLOAT64_IEEE HANcoder_E407_DYS_MP_CM_double 0 0 -1.7E+308 1.7E+308 ECU_ADDRESS 0x200006e0 /end MEASUREMENT
/begin MEASUREMENT NoOtherTruckBoardsErrorView "" FLOAT64_IEEE HANcoder_E407_DYS_MP_CM_double 0 0 -1.7E+308 1.7E+308 ECU_ADDRESS 0x20000758 /end MEASUREMENT
/begin MEASUREMENT AngleVoteErrorView "" FLOAT64_IEEE HANcoder_E407_DYS_MP_CM_double 0 0 -1.7E+308 1.7E+308 ECU_ADDRESS 0x20000650 /end MEASUREMENT
/begin MEASUREMENT NoTrailerAttachErrorView "" FLOAT64_IEEE HANcoder_E407_DYS_MP_CM_double 0 0 -1.7E+308 1.7E+308 ECU_ADDRESS 0x20000760 /end MEASUREMENT
/begin MEASUREMENT BoardIdErrorView "" FLOAT64_IEEE HANcoder_E407_DYS_MP_CM_double 0 0 -1.7E+308 1.7E+308 ECU_ADDRESS 0x20000660 /end MEASUREMENT
/begin MEASUREMENT Board_ID_s "" FLOAT64_IEEE HANcoder_E407_DYS_MP_CM_double 0 0 -1.7E+308 1.7E+308 ECU_ADDRESS 0x20000680 /end MEASUREMENT
/begin MEASUREMENT SI_FreeHeap "" ULONG HANcoder_E407_DYS_MP_CM_uint32 0 0 0 4294967295 ECU_ADDRESS 0x2000078c /end MEASUREMENT
/begin MEASUREMENT SI_FreeStack "" ULONG HANcoder_E407_DYS_MP_CM_uint32 0 0 0 4294967295 ECU_ADDRESS 0x20000790 /end MEASUREMENT
/begin MEASUREMENT MotorGivenSpeed "" ULONG HANcoder_E407_DYS_MP_CM_ufix32_Sp00152587890625 0 0 0 6.5535999984741211E+6 ECU_ADDRESS 0x2000073c /end MEASUREMENT
/begin MEASUREMENT EncPosition "" SLONG HANcoder_E407_DYS_MP_CM_int32 0 0 -2147483648 2147483647 ECU_ADDRESS 0x200006d8 /end MEASUREMENT
/begin MEASUREMENT MotorControl "" UWORD HANcoder_E407_DYS_MP_CM_uint16 0 0 0 65535 ECU_ADDRESS 0x20000738 /end MEASUREMENT
/begin MEASUREMENT LocalTicksBefore "" UWORD HANcoder_E407_DYS_MP_CM_uint16 0 0 0 65535 ECU_ADDRESS 0x20000724 /end MEASUREMENT
/begin MEASUREMENT local_ticks_interrupt "" UWORD HANcoder_E407_DYS_MP_CM_uint16 0 0 0 65535 ECU_ADDRESS 0x20000814 /end MEASUREMENT
/begin MEASUREMENT SI_CPUload "" UBYTE HANcoder_E407_DYS_MP_CM_uint8 0 0 0 255 ECU_ADDRESS 0x2000078a /end MEASUREMENT
/begin MEASUREMENT TrailerOneAttach "" FLOAT64_IEEE HANcoder_E407_DYS_MP_CM_double 0 0 -1.7E+308 1.7E+308 ECU_ADDRESS 0x200007a0 /end MEASUREMENT
/begin MEASUREMENT VoteAngle1 "" FLOAT64_IEEE HANcoder_E407_DYS_MP_CM_double 0 0 -1.7E+308 1.7E+308 ECU_ADDRESS 0x200007b8 /end MEASUREMENT
/begin MEASUREMENT VoteAngle2 "" FLOAT64_IEEE HANcoder_E407_DYS_MP_CM_double 0 0 -1.7E+308 1.7E+308 ECU_ADDRESS 0x200007c0 /end MEASUREMENT
/begin MEASUREMENT VoteAngle3 "" FLOAT64_IEEE HANcoder_E407_DYS_MP_CM_double 0 0 -1.7E+308 1.7E+308 ECU_ADDRESS 0x200007c8 /end MEASUREMENT
/begin MEASUREMENT InputAngleBoard4 "" FLOAT64_IEEE HANcoder_E407_DYS_MP_CM_double 0 0 -1.7E+308 1.7E+308 ECU_ADDRESS 0x20000710 /end MEASUREMENT
/begin MEASUREMENT TrailerTwoAttach "" FLOAT64_IEEE HANcoder_E407_DYS_MP_CM_double 0 0 -1.7E+308 1.7E+308 ECU_ADDRESS 0x200007a8 /end MEASUREMENT
/begin MEASUREMENT InputAngleBoard5 "" FLOAT64_IEEE HANcoder_E407_DYS_MP_CM_double 0 0 -1.7E+308 1.7E+308 ECU_ADDRESS 0x20000718 /end MEASUREMENT
/begin MEASUREMENT VoteEncoder1 "" FLOAT64_IEEE HANcoder_E407_DYS_MP_CM_double 0 0 -1.7E+308 1.7E+308 ECU_ADDRESS 0x200007d0 /end MEASUREMENT
/begin MEASUREMENT VoteEncoder2 "" FLOAT64_IEEE HANcoder_E407_DYS_MP_CM_double 0 0 -1.7E+308 1.7E+308 ECU_ADDRESS 0x200007d8 /end MEASUREMENT
/begin MEASUREMENT VoteEncoder3 "" FLOAT64_IEEE HANcoder_E407_DYS_MP_CM_double 0 0 -1.7E+308 1.7E+308 ECU_ADDRESS 0x200007e0 /end MEASUREMENT
/begin MEASUREMENT DesynckTicks45 "" FLOAT64_IEEE HANcoder_E407_DYS_MP_CM_double 0 0 -1.7E+308 1.7E+308 ECU_ADDRESS 0x200006d0 /end MEASUREMENT
/begin MEASUREMENT CanReceiveCycle "" FLOAT64_IEEE HANcoder_E407_DYS_MP_CM_double 0 0 -1.7E+308 1.7E+308 ECU_ADDRESS 0x20000698 /end MEASUREMENT
/begin MEASUREMENT CanReceived "" FLOAT64_IEEE HANcoder_E407_DYS_MP_CM_double 0 0 -1.7E+308 1.7E+308 ECU_ADDRESS 0x200006a0 /end MEASUREMENT
/begin MEASUREMENT CanSendCycle "" FLOAT64_IEEE HANcoder_E407_DYS_MP_CM_double 0 0 -1.7E+308 1.7E+308 ECU_ADDRESS 0x200006a8 /end MEASUREMENT
/begin MEASUREMENT test1 "" FLOAT64_IEEE HANcoder_E407_DYS_MP_CM_double 0 0 -1.7E+308 1.7E+308 ECU_ADDRESS 0x20000dc8 /end MEASUREMENT
/begin MEASUREMENT testtest "" FLOAT64_IEEE HANcoder_E407_DYS_MP_CM_double 0 0 -1.7E+308 1.7E+308 ECU_ADDRESS 0x20000dd0 /end MEASUREMENT
/begin MEASUREMENT Master_ID_s "" FLOAT64_IEEE HANcoder_E407_DYS_MP_CM_double 0 0 -1.7E+308 1.7E+308 ECU_ADDRESS 0x20000728 /end MEASUREMENT
/begin MEASUREMENT Role_ID_s "" FLOAT64_IEEE HANcoder_E407_DYS_MP_CM_double 0 0 -1.7E+308 1.7E+308 ECU_ADDRESS 0x20000780 /end MEASUREMENT
/begin MEASUREMENT sync_bc0_miss_counter_s "" FLOAT64_IEEE HANcoder_E407_DYS_MP_CM_double 0 0 -1.7E+308 1.7E+308 ECU_ADDRESS 0x20000db8 /end MEASUREMENT
/begin MEASUREMENT sync_bc1_miss_counter_s "" FLOAT64_IEEE HANcoder_E407_DYS_MP_CM_double 0 0 -1.7E+308 1.7E+308 ECU_ADDRESS 0x20000dc0 /end MEASUREMENT
/begin MEASUREMENT set_miss_counter_s "" FLOAT64_IEEE HANcoder_E407_DYS_MP_CM_double 0 0 -1.7E+308 1.7E+308 ECU_ADDRESS 0x20000db0 /end MEASUREMENT
/begin MEASUREMENT sensor_miss_counter_s "" FLOAT64_IEEE HANcoder_E407_DYS_MP_CM_double 0 0 -1.7E+308 1.7E+308 ECU_ADDRESS 0x20000da8 /end MEASUREMENT
/begin MEASUREMENT out1_miss_counter_s "" FLOAT64_IEEE HANcoder_E407_DYS_MP_CM_double 0 0 -1.7E+308 1.7E+308 ECU_ADDRESS 0x20000820 /end MEASUREMENT
/begin MEASUREMENT out2_miss_counter_s "" FLOAT64_IEEE HANcoder_E407_DYS_MP_CM_double 0 0 -1.7E+308 1.7E+308 ECU_ADDRESS 0x20000828 /end MEASUREMENT
/begin MEASUREMENT NoMes1CntCheck "" FLOAT64_IEEE HANcoder_E407_DYS_MP_CM_double 0 0 -1.7E+308 1.7E+308 ECU_ADDRESS 0x20000740 /end MEASUREMENT
/begin MEASUREMENT NoMes2CntCheck "" FLOAT64_IEEE HANcoder_E407_DYS_MP_CM_double 0 0 -1.7E+308 1.7E+308 ECU_ADDRESS 0x20000748 /end MEASUREMENT
/begin MEASUREMENT NoMes3CntCheck "" FLOAT64_IEEE HANcoder_E407_DYS_MP_CM_double 0 0 -1.7E+308 1.7E+308 ECU_ADDRESS 0x20000750 /end MEASUREMENT
/begin MEASUREMENT votes_Board_1_DEBUG "" FLOAT64_IEEE HANcoder_E407_DYS_MP_CM_double 0 0 -1.7E+308 1.7E+308 ECU_ADDRESS 0x20000dd8 /end MEASUREMENT
/begin MEASUREMENT votes_Board_2_DEBUG "" FLOAT64_IEEE HANcoder_E407_DYS_MP_CM_double 0 0 -1.7E+308 1.7E+308 ECU_ADDRESS 0x20000de0 /end MEASUREMENT
/begin MEASUREMENT votes_Board_3_DEBUG "" FLOAT64_IEEE HANcoder_E407_DYS_MP_CM_double 0 0 -1.7E+308 1.7E+308 ECU_ADDRESS 0x20000de8 /end MEASUREMENT
/begin MEASUREMENT Board_1_error_counter_s "" FLOAT64_IEEE HANcoder_E407_DYS_MP_CM_double 0 0 -1.7E+308 1.7E+308 ECU_ADDRESS 0x20000668 /end MEASUREMENT
/begin MEASUREMENT Board_2_error_counter_s "" FLOAT64_IEEE HANcoder_E407_DYS_MP_CM_double 0 0 -1.7E+308 1.7E+308 ECU_ADDRESS 0x20000670 /end MEASUREMENT
/begin MEASUREMENT Board_3_error_counter_s "" FLOAT64_IEEE HANcoder_E407_DYS_MP_CM_double 0 0 -1.7E+308 1.7E+308 ECU_ADDRESS 0x20000678 /end MEASUREMENT
/begin MEASUREMENT ValidatedAngle "" FLOAT64_IEEE HANcoder_E407_DYS_MP_CM_double 0 0 -1.7E+308 1.7E+308 ECU_ADDRESS 0x200007b0 /end MEASUREMENT
/begin MEASUREMENT MessagesOnCan1 "" FLOAT64_IEEE HANcoder_E407_DYS_MP_CM_double 0 0 -1.7E+308 1.7E+308 ECU_ADDRESS 0x20000730 /end MEASUREMENT
/begin MEASUREMENT CanCallsCheck "" FLOAT64_IEEE HANcoder_E407_DYS_MP_CM_double 0 0 -1.7E+308 1.7E+308 ECU_ADDRESS 0x20000688 /end MEASUREMENT
/begin MEASUREMENT ReceiverTimerBlokCalls "" FLOAT64_IEEE HANcoder_E407_DYS_MP_CM_double 0 0 -1.7E+308 1.7E+308 ECU_ADDRESS 0x20000778 /end MEASUREMENT
/begin MEASUREMENT ChancgeLocalTicks "" FLOAT64_IEEE HANcoder_E407_DYS_MP_CM_double 0 0 -1.7E+308 1.7E+308 ECU_ADDRESS 0x200006b8 /end MEASUREMENT
/begin MEASUREMENT EstimatedTimeCan1 "" FLOAT64_IEEE HANcoder_E407_DYS_MP_CM_double 0 0 -1.7E+308 1.7E+308 ECU_ADDRESS 0x200006f0 /end MEASUREMENT
/begin MEASUREMENT EstimatedTimeCan2 "" FLOAT64_IEEE HANcoder_E407_DYS_MP_CM_double 0 0 -1.7E+308 1.7E+308 ECU_ADDRESS 0x20000700 /end MEASUREMENT
/begin MEASUREMENT DesyncTicks "" FLOAT64_IEEE HANcoder_E407_DYS_MP_CM_double 0 0 -1.7E+308 1.7E+308 ECU_ADDRESS 0x200006c8 /end MEASUREMENT
/begin MEASUREMENT msg_count_DEBUG_s "" FLOAT32_IEEE HANcoder_E407_DYS_MP_CM_single 0 0 -3.4E+38 3.4E+38 ECU_ADDRESS 0x20000818 /end MEASUREMENT
/begin MEASUREMENT TestTicka "" UWORD HANcoder_E407_DYS_MP_CM_uint16 0 0 0 65535 ECU_ADDRESS 0x20000794 /end MEASUREMENT
/begin MEASUREMENT LocalIncTicksMes "" UWORD HANcoder_E407_DYS_MP_CM_uint16 0 0 0 65535 ECU_ADDRESS 0x20000720 /end MEASUREMENT
/begin MEASUREMENT LocalIncTicksMes2 "" UWORD HANcoder_E407_DYS_MP_CM_uint16 0 0 0 65535 ECU_ADDRESS 0x20000722 /end MEASUREMENT
/begin MEASUREMENT EstimatedTimeCan1_Init "" UWORD HANcoder_E407_DYS_MP_CM_uint16 0 0 0 65535 ECU_ADDRESS 0x200006f8 /end MEASUREMENT
/begin MEASUREMENT EstimatedTimeCan2_Init "" UWORD HANcoder_E407_DYS_MP_CM_uint16 0 0 0 65535 ECU_ADDRESS 0x20000708 /end MEASUREMENT
/begin MEASUREMENT Rx_init_LT_Init "" UWORD HANcoder_E407_DYS_MP_CM_uint16 0 0 0 65535 ECU_ADDRESS 0x20000788 /end MEASUREMENT
/begin MEASUREMENT CanSendTime "" UBYTE HANcoder_E407_DYS_MP_CM_uint8 0 0 0 255 ECU_ADDRESS 0x200006b0 /end MEASUREMENT
/begin MEASUREMENT bacic_cycle_s "" UBYTE HANcoder_E407_DYS_MP_CM_uint8 0 0 0 255 ECU_ADDRESS 0x200007e8 /end MEASUREMENT
/begin MEASUREMENT Test_CanMes2 "" UBYTE HANcoder_E407_DYS_MP_CM_uint8 0 0 0 255 ECU_ADDRESS 0x20000798 /end MEASUREMENT
/begin MEASUREMENT Test_CanMes0 "" UBYTE HANcoder_E407_DYS_MP_CM_uint8 0 0 0 255 ECU_ADDRESS 0x20000797 /end MEASUREMENT
/begin MEASUREMENT A0OUT "" UBYTE HANcoder_E407_DYS_MP_CM_ufix8_En7 0 0 0 1.9921875 ECU_ADDRESS 0x20000648 /end MEASUREMENT
/begin MEASUREMENT A1OUT "" UBYTE HANcoder_E407_DYS_MP_CM_ufix8_En7 0 0 0 1.9921875 ECU_ADDRESS 0x20000649 /end MEASUREMENT
/begin MEASUREMENT A2OUT "" UBYTE HANcoder_E407_DYS_MP_CM_ufix8_En7 0 0 0 1.9921875 ECU_ADDRESS 0x2000064a /end MEASUREMENT
/begin MEASUREMENT Test_CanRec529 "" SBYTE HANcoder_E407_DYS_MP_CM_int8 0 0 -128 127 ECU_ADDRESS 0x20000799 /end MEASUREMENT
/begin MEASUREMENT Test_Can2Rec529 "" SBYTE HANcoder_E407_DYS_MP_CM_int8 0 0 -128 127 ECU_ADDRESS 0x20000796 /end MEASUREMENT
/begin MEASUREMENT InitFlag "" UBYTE HANcoder_E407_DYS_MP_CM_boolean 0 0 0 1 ECU_ADDRESS 0x2000070a /end MEASUREMENT
/begin MEASUREMENT D4 "" UBYTE HANcoder_E407_DYS_MP_CM_boolean 0 0 0 1 ECU_ADDRESS 0x200006c1 /end MEASUREMENT
/begin MEASUREMENT D5 "" UBYTE HANcoder_E407_DYS_MP_CM_boolean 0 0 0 1 ECU_ADDRESS 0x200006c2 /end MEASUREMENT
/begin MEASUREMENT D6 "" UBYTE HANcoder_E407_DYS_MP_CM_boolean 0 0 0 1 ECU_ADDRESS 0x200006c3 /end MEASUREMENT
/begin MEASUREMENT result_no_id "" UBYTE HANcoder_E407_DYS_MP_CM_boolean 0 0 0 1 ECU_ADDRESS 0x20000830 /end MEASUREMENT
/begin MEASUREMENT result_recieved_2nd "" UBYTE HANcoder_E407_DYS_MP_CM_boolean 0 0 0 1 ECU_ADDRESS 0x20000831 /end MEASUREMENT
/begin MEASUREMENT result_recieved_3d "" UBYTE HANcoder_E407_DYS_MP_CM_boolean 0 0 0 1 ECU_ADDRESS 0x20000832 /end MEASUREMENT
/begin MEASUREMENT result_recieved_4th "" UBYTE HANcoder_E407_DYS_MP_CM_boolean 0 0 0 1 ECU_ADDRESS 0x20000833 /end MEASUREMENT
/begin MEASUREMENT result_recieved_5th "" UBYTE HANcoder_E407_DYS_MP_CM_boolean 0 0 0 1 ECU_ADDRESS 0x20000834 /end MEASUREMENT
/begin MEASUREMENT CanRec_Time "" UBYTE HANcoder_E407_DYS_MP_CM_boolean 0 0 0 1 ECU_ADDRESS 0x20000691 /end MEASUREMENT
/begin MEASUREMENT BC1_sync_processed_s "" UBYTE HANcoder_E407_DYS_MP_CM_boolean 0 0 0 1 ECU_ADDRESS 0x2000065c /end MEASUREMENT
/begin MEASUREMENT BC0_sync_processed_s "" UBYTE HANcoder_E407_DYS_MP_CM_boolean 0 0 0 1 ECU_ADDRESS 0x20000658 /end MEASUREMENT
/begin MEASUREMENT BC0_vote1_processed_s "" UBYTE HANcoder_E407_DYS_MP_CM_boolean 0 0 0 1 ECU_ADDRESS 0x20000659 /end MEASUREMENT
/begin MEASUREMENT BC0_vote2_processed_s "" UBYTE HANcoder_E407_DYS_MP_CM_boolean 0 0 0 1 ECU_ADDRESS 0x2000065a /end MEASUREMENT
/begin MEASUREMENT BC0_vote3_processed_s "" UBYTE HANcoder_E407_DYS_MP_CM_boolean 0 0 0 1 ECU_ADDRESS 0x2000065b /end MEASUREMENT
/begin MEASUREMENT Check "" UBYTE HANcoder_E407_DYS_MP_CM_boolean 0 0 0 1 ECU_ADDRESS 0x200006c0 /end MEASUREMENT
/begin MEASUREMENT CanRec1And2 "" UBYTE HANcoder_E407_DYS_MP_CM_boolean 0 0 0 1 ECU_ADDRESS 0x20000690 /end MEASUREMENT
/begin MEASUREMENT InitTime "" UBYTE HANcoder_E407_DYS_MP_CM_boolean 0 0 0 1 ECU_ADDRESS 0x2000070b /end MEASUREMENT
/begin COMPU_METHOD HANcoder_E407_DYS_MP_CM_double "Q = V" RAT_FUNC "%15.10" "" COEFFS 0 1 0 0 0 1 /end COMPU_METHOD
/begin COMPU_METHOD HANcoder_E407_DYS_MP_CM_uint32 "Q = V" RAT_FUNC "%10.0" "" COEFFS 0 1 0 0 0 1 /end COMPU_METHOD
/begin COMPU_METHOD HANcoder_E407_DYS_MP_CM_ufix32_Sp00152587890625 "Q = V*655.360000" RAT_FUNC "%0.6" "" COEFFS 0 655.360000 0.000000 0 0 1.000000 /end COMPU_METHOD
/begin COMPU_METHOD HANcoder_E407_DYS_MP_CM_int32 "Q = V" RAT_FUNC "%10.0" "" COEFFS 0 1 0 0 0 1 /end COMPU_METHOD
/begin COMPU_METHOD HANcoder_E407_DYS_MP_CM_uint16 "Q = V" RAT_FUNC "%5.0" "" COEFFS 0 1 0 0 0 1 /end COMPU_METHOD
/begin COMPU_METHOD HANcoder_E407_DYS_MP_CM_uint8 "Q = V" RAT_FUNC "%3.0" "" COEFFS 0 1 0 0 0 1 /end COMPU_METHOD
/begin COMPU_METHOD HANcoder_E407_DYS_MP_CM_single "Q = V" RAT_FUNC "%8.6" "" COEFFS 0 1 0 0 0 1 /end COMPU_METHOD
/begin COMPU_METHOD HANcoder_E407_DYS_MP_CM_ufix8_En7 "Q = V*128.000000" RAT_FUNC "%8.7" "" COEFFS 0 128.000000 0.000000 0 0 1.000000 /end COMPU_METHOD
/begin COMPU_METHOD HANcoder_E407_DYS_MP_CM_int8 "Q = V" RAT_FUNC "%3.0" "" COEFFS 0 1 0 0 0 1 /end COMPU_METHOD
/begin COMPU_METHOD HANcoder_E407_DYS_MP_CM_boolean "Q = V" RAT_FUNC "%1.0" "" COEFFS 0 1 0 0 0 1 /end COMPU_METHOD
/begin GROUP HANcoder_E407_DYS_MP "HANcoder_E407_DYS_MP" /* Root */ ROOT /begin SUB_GROUP Root_HANcoder_STM32_Target___E407_STM32_algorithm /end SUB_GROUP /end GROUP
/begin GROUP Root_HANcoder_STM32_Target___E407_STM32_algorithm "HANcoder_E407_DYS_MP/HANcoder STM32 Target - E407-STM32 algorithm"
 /begin SUB_GROUP S1_1_Inputs S1_2_Controller S1_4_TTA_Can_System S1_Observations S1_System_information /end SUB_GROUP
/end GROUP
/begin GROUP S1_1_Inputs "HANcoder_E407_DYS_MP/HANcoder STM32 Target - E407-STM32 algorithm/1.Inputs" /begin SUB_GROUP S2_Quadrature_Encoder_Get /end SUB_GROUP /end GROUP
/begin GROUP S1_2_Controller "HANcoder_E407_DYS_MP/HANcoder STM32 Target - E407-STM32 algorithm/2.Controller" /begin REF_CHARACTERISTIC positionD positionI positionP /end REF_CHARACTERISTIC /begin REF_MEASUREMENT ErrorPID MotorControl PosRound Position /end REF_MEASUREMENT /end GROUP
/begin GROUP S1_4_TTA_Can_System "HANcoder_E407_DYS_MP/HANcoder STM32 Target - E407-STM32 algorithm/4.TTA Can System"
 /begin SUB_GROUP S5_4_1_Local_Time_generation S5_4_3_TTA_System S5_If_Action_Subsystem /end SUB_GROUP
/end GROUP
/begin GROUP S1_Observations "HANcoder_E407_DYS_MP/HANcoder STM32 Target - E407-STM32 algorithm/Observations"
 /begin REF_MEASUREMENT AngleVoteErrorView BoardIdErrorView EncoderValueTestErrorView NoOtherTruckBoardsErrorView NoTrailerAttachErrorView /end REF_MEASUREMENT
/end GROUP
/begin GROUP S1_System_information "HANcoder_E407_DYS_MP/HANcoder STM32 Target - E407-STM32 algorithm/System information" /begin SUB_GROUP S9_Get_CPU_load S9_Get_free_Heap S9_Get_free_Stack /end SUB_GROUP /end GROUP
/begin GROUP S2_Quadrature_Encoder_Get "HANcoder_E407_DYS_MP/HANcoder STM32 Target - E407-STM32 algorithm/1.Inputs/Quadrature Encoder Get" /begin REF_MEASUREMENT EncPosition /end REF_MEASUREMENT /end GROUP
/begin GROUP S5_4_1_Local_Time_generation "HANcoder_E407_DYS_MP/HANcoder STM32 Target - E407-STM32 algorithm/4.TTA Can System/4.1 Local Time generation" /begin REF_MEASUREMENT LocalTicksBefore local_ticks_interrupt /end REF_MEASUREMENT /end GROUP
/begin GROUP S5_4_3_TTA_System "HANcoder_E407_DYS_MP/HANcoder STM32 Target - E407-STM32 algorithm/4.TTA Can System/4.3 TTA System"
 /begin SUB_GROUP S117_4_3_1_Initialization S117_4_3_2_Basic_Cycle_Increment S117_4_3_3_Matrix_Cycle_Manager /end SUB_GROUP
 /begin REF_MEASUREMENT InitFlag /end REF_MEASUREMENT
/end GROUP
/begin GROUP S5_If_Action_Subsystem "HANcoder_E407_DYS_MP/HANcoder STM32 Target - E407-STM32 algorithm/4.TTA Can System/If Action Subsystem" /begin REF_MEASUREMENT Board_ID_s /end REF_MEASUREMENT /end GROUP
/begin GROUP S9_Get_CPU_load "HANcoder_E407_DYS_MP/HANcoder STM32 Target - E407-STM32 algorithm/System information/Get CPU load" /begin REF_MEASUREMENT SI_CPUload /end REF_MEASUREMENT /end GROUP
/begin GROUP S9_Get_free_Heap "HANcoder_E407_DYS_MP/HANcoder STM32 Target - E407-STM32 algorithm/System information/Get free Heap" /begin REF_MEASUREMENT SI_FreeHeap /end REF_MEASUREMENT /end GROUP
/begin GROUP S9_Get_free_Stack "HANcoder_E407_DYS_MP/HANcoder STM32 Target - E407-STM32 algorithm/System information/Get free Stack" /begin REF_MEASUREMENT SI_FreeStack /end REF_MEASUREMENT /end GROUP
/begin GROUP S117_4_3_1_Initialization "HANcoder_E407_DYS_MP/HANcoder STM32 Target - E407-STM32 algorithm/4.TTA Can System/4.3 TTA System/4.3.1 Initialization"
 /begin SUB_GROUP S125_Delay S125_Receive_can_message S125_RoleID_and_Global_Time_init /end SUB_GROUP
 /begin REF_MEASUREMENT CanRec1And2 Check /end REF_MEASUREMENT
/end GROUP
/begin GROUP S117_4_3_2_Basic_Cycle_Increment "HANcoder_E407_DYS_MP/HANcoder STM32 Target - E407-STM32 algorithm/4.TTA Can System/4.3 TTA System/4.3.2 Basic Cycle Increment" /begin REF_MEASUREMENT bacic_cycle_s /end REF_MEASUREMENT /end GROUP
/begin GROUP S117_4_3_3_Matrix_Cycle_Manager "HANcoder_E407_DYS_MP/HANcoder STM32 Target - E407-STM32 algorithm/4.TTA Can System/4.3 TTA System/4.3.3 Matrix Cycle Manager"
 /begin SUB_GROUP S127_4_3_3_1_Controller_Matrix_Cycle_Truck_Boards_1_2_and_3 S127_4_3_3_2_Controller_Matrix_Cycle_Board_4_and_5 S127_4_3_3_3_Send_the_next_Board_ID S127_Matrix_Cycle_Observation_DEBUG /end SUB_GROUP
/end GROUP
/begin GROUP S30_Enabled "HANcoder_E407_DYS_MP/HANcoder STM32 Target - E407-STM32 algorithm/2.Controller/Discrete PID Controller/Saturation/Enabled" /begin REF_MEASUREMENT MotorGivenSpeed /end REF_MEASUREMENT /end GROUP
/begin GROUP S125_Delay "HANcoder_E407_DYS_MP/HANcoder STM32 Target - E407-STM32 algorithm/4.TTA Can System/4.3 TTA System/4.3.1 Initialization/Delay" /begin REF_MEASUREMENT InitTime /end REF_MEASUREMENT /end GROUP
/begin GROUP S125_Receive_can_message "HANcoder_E407_DYS_MP/HANcoder STM32 Target - E407-STM32 algorithm/4.TTA Can System/4.3 TTA System/4.3.1 Initialization/Receive can message" /begin SUB_GROUP S129_CAN_receive S129_CAN_receive2 /end SUB_GROUP /end GROUP
/begin GROUP S125_RoleID_and_Global_Time_init "HANcoder_E407_DYS_MP/HANcoder STM32 Target - E407-STM32 algorithm/4.TTA Can System/4.3 TTA System/4.3.1 Initialization/RoleID and Global Time init" /begin SUB_GROUP S130_Global_Time_Initialization_Slave /end SUB_GROUP /end GROUP
/begin GROUP S127_4_3_3_1_Controller_Matrix_Cycle_Truck_Boards_1_2_and_3 "HANcoder_E407_DYS_MP/HANcoder STM32 Target - E407-STM32 algorithm/4.TTA Can System/4.3 TTA System/4.3.3 Matrix Cycle Manager/4.3.3.1 Controller Matrix Cycle Truck Boards 1 2 and 3"
 /begin SUB_GROUP S137_4_3_3_1_1_controller_basic_cycle_0_1 S137_4_3_3_1_2_controller_basic_cycle_0_2 S137_Matrix_Cycle_Observation_DEBUG S137_msg_count_DEBUG_observer /end SUB_GROUP
/end GROUP
/begin GROUP S127_4_3_3_2_Controller_Matrix_Cycle_Board_4_and_5 "HANcoder_E407_DYS_MP/HANcoder STM32 Target - E407-STM32 algorithm/4.TTA Can System/4.3 TTA System/4.3.3 Matrix Cycle Manager/4.3.3.2 Controller Matrix Cycle_Board 4 and 5" /begin SUB_GROUP S138_controller_basic_cycle_0 /end SUB_GROUP /end GROUP
/begin GROUP S127_4_3_3_3_Send_the_next_Board_ID "HANcoder_E407_DYS_MP/HANcoder STM32 Target - E407-STM32 algorithm/4.TTA Can System/4.3 TTA System/4.3.3 Matrix Cycle Manager/4.3.3.3 Send the next Board ID"
 /begin SUB_GROUP S139_Digital_Input4 S139_Digital_Input5 S139_Digital_Input6 /end SUB_GROUP
 /begin REF_MEASUREMENT A0OUT A1OUT A2OUT result_no_id result_recieved_2nd result_recieved_3d result_recieved_4th result_recieved_5th /end REF_MEASUREMENT
/end GROUP
/begin GROUP S127_Matrix_Cycle_Observation_DEBUG "HANcoder_E407_DYS_MP/HANcoder STM32 Target - E407-STM32 algorithm/4.TTA Can System/4.3 TTA System/4.3.3 Matrix Cycle Manager/Matrix_Cycle_Observation_DEBUG"
 /begin REF_MEASUREMENT InputAngleBoard4 InputAngleBoard5 TrailerOneAttach TrailerTwoAttach VoteAngle1 VoteAngle2 VoteAngle3 VoteEncoder1 VoteEncoder2 VoteEncoder3 /end REF_MEASUREMENT
/end GROUP
/begin GROUP S129_CAN_receive "HANcoder_E407_DYS_MP/HANcoder STM32 Target - E407-STM32 algorithm/4.TTA Can System/4.3 TTA System/4.3.1 Initialization/Receive can message/CAN receive" /begin SUB_GROUP S131_Enabled_Subsystem /end SUB_GROUP /begin REF_MEASUREMENT Test_CanRec529 /end REF_MEASUREMENT /end GROUP
/begin GROUP S129_CAN_receive2 "HANcoder_E407_DYS_MP/HANcoder STM32 Target - E407-STM32 algorithm/4.TTA Can System/4.3 TTA System/4.3.1 Initialization/Receive can message/CAN receive2" /begin SUB_GROUP S132_Enabled_Subsystem /end SUB_GROUP /begin REF_MEASUREMENT Test_Can2Rec529 /end REF_MEASUREMENT /end GROUP
/begin GROUP S130_Global_Time_Initialization_Slave "HANcoder_E407_DYS_MP/HANcoder STM32 Target - E407-STM32 algorithm/4.TTA Can System/4.3 TTA System/4.3.1 Initialization/RoleID and Global Time init/Global Time Initialization Slave"
 /begin REF_MEASUREMENT EstimatedTimeCan1_Init EstimatedTimeCan2_Init Rx_init_LT_Init /end REF_MEASUREMENT
/end GROUP
/begin GROUP S137_4_3_3_1_1_controller_basic_cycle_0_1 "HANcoder_E407_DYS_MP/HANcoder STM32 Target - E407-STM32 algorithm/4.TTA Can System/4.3 TTA System/4.3.3 Matrix Cycle Manager/4.3.3.1 Controller Matrix Cycle Truck Boards 1 2 and 3/4.3.3.1.1 controller basic cycle 0.1"
 /begin SUB_GROUP S141_Desync_calculation S141_If_Action_Subsystem S141_Receive_Timer_can_master_message_ /end SUB_GROUP
 /begin REF_MEASUREMENT CanRec_Time CanReceiveCycle CanReceived CanSendCycle CanSendTime TestTicka /end REF_MEASUREMENT
/end GROUP
/begin GROUP S137_4_3_3_1_2_controller_basic_cycle_0_2 "HANcoder_E407_DYS_MP/HANcoder STM32 Target - E407-STM32 algorithm/4.TTA Can System/4.3 TTA System/4.3.3 Matrix Cycle Manager/4.3.3.1 Controller Matrix Cycle Truck Boards 1 2 and 3/4.3.3.1.2 controller basic cycle 0.2" /begin SUB_GROUP S142_If_Action_Subsystem S142_If_Action_Subsystem2 /end SUB_GROUP /begin REF_MEASUREMENT test1 testtest /end REF_MEASUREMENT /end GROUP
/begin GROUP S137_Matrix_Cycle_Observation_DEBUG "HANcoder_E407_DYS_MP/HANcoder STM32 Target - E407-STM32 algorithm/4.TTA Can System/4.3 TTA System/4.3.3 Matrix Cycle Manager/4.3.3.1 Controller Matrix Cycle Truck Boards 1 2 and 3/Matrix_Cycle_Observation_DEBUG"
 /begin REF_MEASUREMENT BC0_sync_processed_s BC0_vote1_processed_s BC0_vote2_processed_s BC0_vote3_processed_s BC1_sync_processed_s Board_1_error_counter_s Board_2_error_counter_s Board_3_error_counter_s Master_ID_s NoMes1CntCheck NoMes2CntCheck NoMes3CntCheck Role_ID_s out1_miss_counter_s out2_miss_counter_s sensor_miss_counter_s set_miss_counter_s sync_bc0_miss_counter_s sync_bc1_miss_counter_s votes_Board_1_DEBUG votes_Board_2_DEBUG votes_Board_3_DEBUG /end REF_MEASUREMENT
/end GROUP
/begin GROUP S137_msg_count_DEBUG_observer "HANcoder_E407_DYS_MP/HANcoder STM32 Target - E407-STM32 algorithm/4.TTA Can System/4.3 TTA System/4.3.3 Matrix Cycle Manager/4.3.3.1 Controller Matrix Cycle Truck Boards 1 2 and 3/msg_count_DEBUG observer" /begin REF_MEASUREMENT msg_count_DEBUG_s /end REF_MEASUREMENT /end GROUP
/begin GROUP S138_controller_basic_cycle_0 "HANcoder_E407_DYS_MP/HANcoder STM32 Target - E407-STM32 algorithm/4.TTA Can System/4.3 TTA System/4.3.3 Matrix Cycle Manager/4.3.3.2 Controller Matrix Cycle_Board 4 and 5/controller basic cycle 0" /begin SUB_GROUP S283_Desync_calculation /end SUB_GROUP /end GROUP
/begin GROUP S139_Digital_Input4 "HANcoder_E407_DYS_MP/HANcoder STM32 Target - E407-STM32 algorithm/4.TTA Can System/4.3 TTA System/4.3.3 Matrix Cycle Manager/4.3.3.3 Send the next Board ID/Digital Input4" /begin REF_MEASUREMENT D4 /end REF_MEASUREMENT /end GROUP
/begin GROUP S139_Digital_Input5 "HANcoder_E407_DYS_MP/HANcoder STM32 Target - E407-STM32 algorithm/4.TTA Can System/4.3 TTA System/4.3.3 Matrix Cycle Manager/4.3.3.3 Send the next Board ID/Digital Input5" /begin REF_MEASUREMENT D5 /end REF_MEASUREMENT /end GROUP
/begin GROUP S139_Digital_Input6 "HANcoder_E407_DYS_MP/HANcoder STM32 Target - E407-STM32 algorithm/4.TTA Can System/4.3 TTA System/4.3.3 Matrix Cycle Manager/4.3.3.3 Send the next Board ID/Digital Input6" /begin REF_MEASUREMENT D6 /end REF_MEASUREMENT /end GROUP
/begin GROUP S131_Enabled_Subsystem "HANcoder_E407_DYS_MP/HANcoder STM32 Target - E407-STM32 algorithm/4.TTA Can System/4.3 TTA System/4.3.1 Initialization/Receive can message/CAN receive/Enabled Subsystem" /begin REF_MEASUREMENT Test_CanMes0 /end REF_MEASUREMENT /end GROUP
/begin GROUP S132_Enabled_Subsystem "HANcoder_E407_DYS_MP/HANcoder STM32 Target - E407-STM32 algorithm/4.TTA Can System/4.3 TTA System/4.3.1 Initialization/Receive can message/CAN receive2/Enabled Subsystem" /begin REF_MEASUREMENT Test_CanMes2 /end REF_MEASUREMENT /end GROUP
/begin GROUP S141_Desync_calculation "HANcoder_E407_DYS_MP/HANcoder STM32 Target - E407-STM32 algorithm/4.TTA Can System/4.3 TTA System/4.3.3 Matrix Cycle Manager/4.3.3.1 Controller Matrix Cycle Truck Boards 1 2 and 3/4.3.3.1.1 controller basic cycle 0.1/Desync calculation"
 /begin REF_MEASUREMENT DesyncTicks EstimatedTimeCan1 EstimatedTimeCan2 LocalIncTicksMes LocalIncTicksMes2 /end REF_MEASUREMENT
/end GROUP
/begin GROUP S141_If_Action_Subsystem "HANcoder_E407_DYS_MP/HANcoder STM32 Target - E407-STM32 algorithm/4.TTA Can System/4.3 TTA System/4.3.3 Matrix Cycle Manager/4.3.3.1 Controller Matrix Cycle Truck Boards 1 2 and 3/4.3.3.1.1 controller basic cycle 0.1/If Action Subsystem" /begin REF_MEASUREMENT ChancgeLocalTicks /end REF_MEASUREMENT /end GROUP
/begin GROUP S141_Receive_Timer_can_master_message_ "HANcoder_E407_DYS_MP/HANcoder STM32 Target - E407-STM32 algorithm/4.TTA Can System/4.3 TTA System/4.3.3 Matrix Cycle Manager/4.3.3.1 Controller Matrix Cycle Truck Boards 1 2 and 3/4.3.3.1.1 controller basic cycle 0.1/Receive Timer can master message " /begin REF_MEASUREMENT CanCallsCheck MessagesOnCan1 ReceiverTimerBlokCalls /end REF_MEASUREMENT /end GROUP
/begin GROUP S142_If_Action_Subsystem "HANcoder_E407_DYS_MP/HANcoder STM32 Target - E407-STM32 algorithm/4.TTA Can System/4.3 TTA System/4.3.3 Matrix Cycle Manager/4.3.3.1 Controller Matrix Cycle Truck Boards 1 2 and 3/4.3.3.1.2 controller basic cycle 0.2/If Action Subsystem" /begin REF_CHARACTERISTIC HantuneAngleSp /end REF_CHARACTERISTIC /end GROUP
/begin GROUP S142_If_Action_Subsystem2 "HANcoder_E407_DYS_MP/HANcoder STM32 Target - E407-STM32 algorithm/4.TTA Can System/4.3 TTA System/4.3.3 Matrix Cycle Manager/4.3.3.1 Controller Matrix Cycle Truck Boards 1 2 and 3/4.3.3.1.2 controller basic cycle 0.2/If Action Subsystem2" /begin SUB_GROUP S193_If_Action_Subsystem2 /end SUB_GROUP /end GROUP
/begin GROUP S283_Desync_calculation "HANcoder_E407_DYS_MP/HANcoder STM32 Target - E407-STM32 algorithm/4.TTA Can System/4.3 TTA System/4.3.3 Matrix Cycle Manager/4.3.3.2 Controller Matrix Cycle_Board 4 and 5/controller basic cycle 0/Desync calculation" /begin REF_MEASUREMENT DesynckTicks45 /end REF_MEASUREMENT /end GROUP
/begin GROUP S193_If_Action_Subsystem2 "HANcoder_E407_DYS_MP/HANcoder STM32 Target - E407-STM32 algorithm/4.TTA Can System/4.3 TTA System/4.3.3 Matrix Cycle Manager/4.3.3.1 Controller Matrix Cycle Truck Boards 1 2 and 3/4.3.3.1.2 controller basic cycle 0.2/If Action Subsystem2/If Action Subsystem2" /begin REF_MEASUREMENT ValidatedAngle /end REF_MEASUREMENT /end GROUP
/end MODULE
/end PROJECT
/* (add any file trailer comments here) */
/* EOF HANcoder_E407_DYS_MP.a2l */
